
qcom,jsr-4v35-3000mAh-ruilong-data {
	qcom,fcc-mah = <3000>;
	qcom,default-rbatt-mohm = <127>;
	qcom,rbatt-capacitive-mohm = <0>;
	qcom,flat-ocv-threshold-uv = <3800000>;
	qcom,max-voltage-uv = <4350000>;
	qcom,v-cutoff-uv = <3400000>;
	qcom,chg-term-ua = <100000>;
	qcom,batt-id-kohm = <47>;

	qcom,rbatt-sf-lut {
		qcom,lut-col-legend = <(-20) 0 25 40 60>;
		qcom,lut-row-legend = <100 95 90 85 80>,
				<75 70 65 60 55>,
				<50 45 40 35 30>,
				<25 20 16 13 11>,
				<10 9 8 7 6>,
				<5 4 3 2 1>;
		qcom,lut-data = <0x64 0x64 0x64 0x64 0x64 
				0x64 0x64 0x64 0x64 0x64 
				0x66 0x66 0x66 0x66 0x66 
				0x69 0x69 0x69 0x69 0x69 
				0x6f 0x6f 0x6f 0x6f 0x6f 
				0x76 0x76 0x76 0x76 0x76 
				0x7a 0x7a 0x7a 0x7a 0x7a 
				0x7c 0x7c 0x7c 0x7c 0x7c 
				0x6b 0x6b 0x6b 0x6b 0x6b 
				0x65 0x65 0x65 0x65 0x65 
				0x65 0x65 0x65 0x65 0x65 
				0x67 0x67 0x67 0x67 0x67 
				0x69 0x69 0x69 0x69 0x69 
				0x6b 0x6b 0x6b 0x6b 0x6b 
				0x6a 0x6a 0x6a 0x6a 0x6a 
				0x67 0x67 0x67 0x67 0x67 
				0x69 0x69 0x69 0x69 0x69 
				0x6a 0x6a 0x6a 0x6a 0x6a 
				0x66 0x66 0x66 0x66 0x66 
				0x68 0x68 0x68 0x68 0x68 
				0x6b 0x6b 0x6b 0x6b 0x6b 
				0x6f 0x6f 0x6f 0x6f 0x6f 
				0x73 0x73 0x73 0x73 0x73 
				0x76 0x76 0x76 0x76 0x76 
				0x75 0x75 0x75 0x75 0x75 
				0x79 0x79 0x79 0x79 0x79 
				0x7e 0x7e 0x7e 0x7e 0x7e 
				0x89 0x89 0x89 0x89 0x89 
				0xa2 0xa2 0xa2 0xa2 0xa2 
				0x894 0x894 0x894 0x894 0x894>;
	};

	qcom,fcc-temp-lut {
		qcom,lut-col-legend = <(-20) 0 25 40 60>;
		qcom,lut-data = <0xc03 0xc03 0xc03 0xc03 0xc03>;
	};

	qcom,pc-temp-ocv-lut {
		qcom,lut-col-legend = <(-20) 0 25 40 60>;
		qcom,lut-row-legend = <100 95 90 85 80>,
				<75 70 65 60 55>,
				<50 45 40 35 30>,
				<25 20 16 13 11>,
				<10 9 8 7 6>,
				<5 4 3 2 1>,
				<0>;
		qcom,lut-data = <0x10e6 0x10e6 0x10e6 0x10e6 0x10e6 
				0x10a4 0x10a4 0x10a4 0x10a4 0x10a4 
				0x106a 0x106a 0x106a 0x106a 0x106a 
				0x1034 0x1034 0x1034 0x1034 0x1034 
				0x1000 0x1000 0x1000 0x1000 0x1000 
				0xfd3 0xfd3 0xfd3 0xfd3 0xfd3 
				0xf9a 0xf9a 0xf9a 0xf9a 0xf9a 
				0xf70 0xf70 0xf70 0xf70 0xf70 
				0xf40 0xf40 0xf40 0xf40 0xf40 
				0xf1b 0xf1b 0xf1b 0xf1b 0xf1b 
				0xf00 0xf00 0xf00 0xf00 0xf00 
				0xee9 0xee9 0xee9 0xee9 0xee9 
				0xed6 0xed6 0xed6 0xed6 0xed6 
				0xec5 0xec5 0xec5 0xec5 0xec5 
				0xeb5 0xeb5 0xeb5 0xeb5 0xeb5 
				0xea5 0xea5 0xea5 0xea5 0xea5 
				0xe93 0xe93 0xe93 0xe93 0xe93 
				0xe7f 0xe7f 0xe7f 0xe7f 0xe7f 
				0xe6e 0xe6e 0xe6e 0xe6e 0xe6e 
				0xe69 0xe69 0xe69 0xe69 0xe69 
				0xe67 0xe67 0xe67 0xe67 0xe67 
				0xe64 0xe64 0xe64 0xe64 0xe64 
				0xe60 0xe60 0xe60 0xe60 0xe60 
				0xe55 0xe55 0xe55 0xe55 0xe55 
				0xe3b 0xe3b 0xe3b 0xe3b 0xe3b 
				0xe15 0xe15 0xe15 0xe15 0xe15 
				0xde3 0xde3 0xde3 0xde3 0xde3 
				0xda1 0xda1 0xda1 0xda1 0xda1 
				0xd45 0xd45 0xd45 0xd45 0xd45 
				0xcb6 0xcb6 0xcb6 0xcb6 0xcb6 
				0xbb8 0xbb8 0xbb8 0xbb8 0xbb8>;
	};
};
