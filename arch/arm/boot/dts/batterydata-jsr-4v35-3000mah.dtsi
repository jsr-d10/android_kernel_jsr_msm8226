
qcom,jsr-4v35-3000mAh-data {
	qcom,fcc-mah = <3000>;
	qcom,default-rbatt-mohm = <146>;
	qcom,rbatt-capacitive-mohm = <0>;
	qcom,flat-ocv-threshold-uv = <3800000>;
	qcom,max-voltage-uv = <4350000>;
	qcom,v-cutoff-uv = <3400000>;
	qcom,chg-term-ua = <100000>;
	qcom,batt-id-kohm = <10>;

	qcom,rbatt-sf-lut {
		qcom,lut-col-legend = <(-20) (-10) 0 25 40 60>;
		qcom,lut-row-legend = <100 95 90 85 80>,
				<75 70 65 60 55>,
				<50 45 40 35 30>,
				<25 20 16 13 11>,
				<10 9 8 7 6>,
				<5 4 3 2 1>;
		qcom,lut-data = <0x301 0x18a 0xd1 0x64 0x57 0x52 
				0x307 0x18c 0xd4 0x65 0x57 0x52 
				0x30d 0x190 0xd7 0x66 0x58 0x53 
				0x30f 0x194 0xdd 0x68 0x59 0x54 
				0x32f 0x19e 0xdc 0x6c 0x5d 0x55 
				0x308 0x19b 0xe6 0x71 0x5f 0x56 
				0x300 0x185 0xd6 0x75 0x62 0x59 
				0x31d 0x18c 0xd5 0x75 0x64 0x5b 
				0x331 0x18d 0xd4 0x68 0x5b 0x54 
				0x346 0x18d 0xd2 0x64 0x59 0x53 
				0x361 0x192 0xd3 0x64 0x59 0x54 
				0x386 0x198 0xd5 0x67 0x59 0x54 
				0x3b4 0x19f 0xd6 0x68 0x5d 0x56 
				0x3f1 0x1ac 0xd7 0x6a 0x5d 0x58 
				0x44e 0x1c0 0xda 0x66 0x59 0x54 
				0x4cd 0x1df 0xd9 0x64 0x56 0x52 
				0x565 0x215 0xdb 0x66 0x59 0x54 
				0x5da 0x250 0xea 0x67 0x59 0x54 
				0x64a 0x279 0xfc 0x66 0x59 0x54 
				0x600 0x25a 0x100 0x66 0x59 0x54 
				0x5b6 0x25a 0xfe 0x67 0x5b 0x56 
				0x5a4 0x25a 0xfc 0x6a 0x5c 0x56 
				0x62e 0x275 0xfe 0x6c 0x5d 0x59 
				0x6ed 0x29b 0x101 0x6e 0x5e 0x58 
				0x816 0x2d1 0x102 0x6c 0x5b 0x55 
				0x978 0x319 0x107 0x6a 0x5b 0x55 
				0xba8 0x37d 0x10f 0x6b 0x5d 0x56 
				0xfab 0x410 0x11c 0x6e 0x5d 0x57 
				0x1e2f 0x4fe 0x136 0x73 0x60 0x5b 
				0x6765 0x873 0x8f7 0x84 0x6e 0x70>;
	};

	qcom,fcc-temp-lut {
		qcom,lut-col-legend = <(-20) (-10) 0 25 40 60>;
		qcom,lut-data = <0xbb1 0xbc3 0xbc4 0xbcb 0xbcb 0xbc1>;
	};

	qcom,pc-temp-ocv-lut {
		qcom,lut-col-legend = <(-20) (-10) 0 25 40 60>;
		qcom,lut-row-legend = <100 95 90 85 80>,
				<75 70 65 60 55>,
				<50 45 40 35 30>,
				<25 20 16 13 11>,
				<10 9 8 7 6>,
				<5 4 3 2 1>,
				<0>;
		qcom,lut-data = <0x10e1 0x10e1 0x10e0 0x10df 0x10da 0x10d0 
				0x108f 0x1094 0x109a 0x109a 0x1098 0x1092 
				0x1053 0x105a 0x1061 0x1062 0x105f 0x105a 
				0x1016 0x1021 0x102b 0x102c 0x1029 0x1024 
				0xfec 0xff2 0xff8 0xffa 0xff6 0xff0 
				0xf8b 0xf9f 0xfb9 0xfcb 0xfc9 0xfc0 
				0xf4f 0xf5f 0xf6d 0xf89 0xf91 0xf94 
				0xf30 0xf42 0xf4e 0xf67 0xf6b 0xf68 
				0xf0f 0xf23 0xf2f 0xf38 0xf39 0xf37 
				0xeef 0xf03 0xf10 0xf15 0xf15 0xf13 
				0xed4 0xee7 0xef4 0xefa 0xefb 0xef9 
				0xec0 0xed0 0xedc 0xee5 0xee5 0xee3 
				0xeb1 0xebe 0xec8 0xed3 0xed4 0xed1 
				0xea4 0xeb2 0xeb8 0xec3 0xec3 0xec1 
				0xe95 0xea6 0xeac 0xeb3 0xeaf 0xea6 
				0xe84 0xe9b 0xe9d 0xea4 0xe9c 0xe8e 
				0xe6d 0xe8e 0xe8e 0xe93 0xe8b 0xe7d 
				0xe55 0xe81 0xe84 0xe82 0xe79 0xe6b 
				0xe3f 0xe73 0xe7a 0xe70 0xe67 0xe5c 
				0xe2d 0xe66 0xe73 0xe6a 0xe62 0xe56 
				0xe22 0xe5e 0xe6d 0xe68 0xe60 0xe54 
				0xe15 0xe55 0xe65 0xe66 0xe5e 0xe52 
				0xe05 0xe49 0xe5a 0xe63 0xe5b 0xe4e 
				0xdf2 0xe39 0xe4b 0xe5c 0xe53 0xe44 
				0xddb 0xe25 0xe35 0xe49 0xe3f 0xe2c 
				0xdbc 0xe0b 0xe17 0xe27 0xe1c 0xe07 
				0xd94 0xde8 0xdf0 0xdfa 0xdef 0xdd8 
				0xd5d 0xdb7 0xdb9 0xdc0 0xdb5 0xd9c 
				0xd09 0xd70 0xd69 0xd70 0xd66 0xd4b 
				0xc8f 0xcf8 0xce5 0xcf5 0xcec 0xcc9 
				0xbb8 0xbb8 0xbb8 0xbb8 0xbb8 0xbb8>;
	};
};
