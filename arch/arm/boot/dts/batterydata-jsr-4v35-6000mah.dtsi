
qcom,jsr-4v35-6000mAh-data {
	qcom,fcc-mah = <6000>;
	qcom,default-rbatt-mohm = <80>;
	qcom,rbatt-capacitive-mohm = <0>;
	qcom,flat-ocv-threshold-uv = <3800000>;
	qcom,max-voltage-uv = <4350000>;
	qcom,v-cutoff-uv = <3400000>;
	qcom,chg-term-ua = <100000>;
	qcom,batt-id-kohm = <100>;

	qcom,rbatt-sf-lut {
		qcom,lut-col-legend = <(-20) (-10) 0 25 40 60>;
		qcom,lut-row-legend = <100 95 90 85 80>,
				<75 70 65 60 55>,
				<50 45 40 35 30>,
				<25 20 16 13 11>,
				<10 9 8 7 6>,
				<5 4 3 2 1>;
		qcom,lut-data = <0x2a9 0x143 0xb4 0x64 0x5c 0x5a 
				0x2a9 0x143 0xb4 0x64 0x5c 0x5a 
				0x2ad 0x14a 0xba 0x65 0x5c 0x5b 
				0x2b2 0x150 0xc3 0x66 0x5d 0x5b 
				0x2af 0x151 0xcb 0x6b 0x60 0x5c 
				0x2c6 0x15a 0xd5 0x6f 0x62 0x5d 
				0x29e 0x145 0xc6 0x70 0x64 0x5f 
				0x2a0 0x142 0xbb 0x75 0x66 0x61 
				0x2a6 0x143 0xb6 0x6a 0x60 0x5d 
				0x2a6 0x142 0xb4 0x64 0x5d 0x5b 
				0x2aa 0x142 0xb4 0x64 0x5d 0x5b 
				0x2b4 0x145 0xb6 0x65 0x5d 0x5b 
				0x2c3 0x146 0xb7 0x66 0x5f 0x5d 
				0x2d7 0x14a 0xba 0x66 0x60 0x5f 
				0x2f1 0x14a 0xbc 0x65 0x5d 0x5c 
				0x319 0x14f 0xbe 0x64 0x5c 0x5b 
				0x350 0x15f 0xbe 0x65 0x5c 0x5c 
				0x38b 0x17d 0xbc 0x65 0x5d 0x5c 
				0x3b7 0x192 0xbc 0x65 0x5c 0x5b 
				0x39e 0x189 0xc4 0x65 0x5d 0x5c 
				0x3b8 0x18d 0xc9 0x66 0x5d 0x5c 
				0x3dc 0x196 0xd2 0x67 0x5f 0x5d 
				0x409 0x19b 0xd9 0x69 0x60 0x5f 
				0x43e 0x1a6 0xdf 0x6b 0x61 0x5f 
				0x483 0x1af 0xe2 0x69 0x60 0x5c 
				0x4e3 0x1be 0xe3 0x67 0x60 0x5d 
				0x562 0x1d2 0xe7 0x6a 0x60 0x5f 
				0x62f 0x1ec 0xee 0x6c 0x61 0x60 
				0x8eb 0x222 0xfd 0x70 0x65 0x61 
				0x2254 0x2bf 0x33e 0x92 0x71 0x75>;
	};

	qcom,fcc-temp-lut {
		qcom,lut-col-legend = <(-20) (-10) 0 25 40 60>;
		qcom,lut-data = <0x17e1 0x17f5 0x17f8 0x17f9 0x17f2 0x17d9>;
	};

	qcom,pc-temp-ocv-lut {
		qcom,lut-col-legend = <(-20) (-10) 0 25 40 60>;
		qcom,lut-row-legend = <100 95 90 85 80>,
				<75 70 65 60 55>,
				<50 45 40 35 30>,
				<25 20 16 13 11>,
				<10 9 8 7 6>,
				<5 4 3 2 1>,
				<0>;
		qcom,lut-data = <0x10f3 0x10f2 0x10f1 0x10ed 0x10ea 0x10e3 
				0x10a1 0x10a8 0x10ab 0x10aa 0x10a7 0x10a2 
				0x1064 0x106e 0x1071 0x1070 0x106e 0x1068 
				0x102b 0x1035 0x103b 0x1039 0x1036 0x1031 
				0xff3 0xffd 0x1006 0x1005 0x1002 0xffc 
				0xfb8 0xfcb 0xfd9 0xfdb 0xfd4 0xfcb 
				0xf65 0xf73 0xf80 0xf95 0xf9a 0xf9d 
				0xf3e 0xf4c 0xf56 0xf70 0xf73 0xf70 
				0xf20 0xf30 0xf38 0xf40 0xf41 0xf3e 
				0xf00 0xf10 0xf17 0xf1a 0xf1a 0xf18 
				0xee3 0xef4 0xefb 0xefe 0xefe 0xefc 
				0xeca 0xedb 0xee3 0xee8 0xee8 0xee6 
				0xeb7 0xec6 0xed0 0xed6 0xed5 0xed3 
				0xea8 0xeb5 0xec0 0xec6 0xec5 0xec2 
				0xe9a 0xea7 0xeb4 0xeb5 0xeb2 0xeaa 
				0xe8a 0xe9a 0xea7 0xea6 0xe9d 0xe90 
				0xe75 0xe8d 0xe96 0xe94 0xe8b 0xe7d 
				0xe60 0xe81 0xe85 0xe82 0xe79 0xe6b 
				0xe4a 0xe74 0xe7a 0xe70 0xe67 0xe5b 
				0xe3a 0xe69 0xe75 0xe6a 0xe61 0xe55 
				0xe2e 0xe60 0xe71 0xe68 0xe60 0xe54 
				0xe22 0xe56 0xe6d 0xe66 0xe5e 0xe52 
				0xe13 0xe49 0xe65 0xe63 0xe5b 0xe4e 
				0xe01 0xe39 0xe58 0xe5e 0xe55 0xe46 
				0xdeb 0xe24 0xe44 0xe4e 0xe43 0xe31 
				0xdd0 0xe0a 0xe27 0xe2d 0xe21 0xe0c 
				0xdae 0xde8 0xe01 0xe00 0xdf4 0xdde 
				0xd7f 0xdb8 0xdcd 0xdc6 0xdba 0xda3 
				0xd39 0xd73 0xd82 0xd77 0xd6c 0xd52 
				0xcc4 0xcfc 0xd07 0xcf9 0xcf2 0xcd1 
				0xbb8 0xbb8 0xbb8 0xbb8 0xbb8 0xbb8>;
	};
};
