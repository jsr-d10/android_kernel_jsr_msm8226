

&soc {
	i2c@f9923000 {    /* BLSP-1 QUP-1 */
		cell-index = <3>;
		compatible = "qcom,i2c-qup";
		reg = <0xf9923000 0x1000>;
		#address-cells = <0x1>;
		#size-cells = <0x0>;
		reg-names = "qup_phys_addr";
		interrupts = <0 95 0>;
		interrupt-names = "qup_err_intr";
		qcom,i2c-bus-freq = <100000>;
		/* ---- msm-tricolor-leds ----  */
		bct@30 {
			compatible = "bct,bct3253";
			reg = <0x30>;
		};
	}; 
};
