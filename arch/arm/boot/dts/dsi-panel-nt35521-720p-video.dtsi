/* Copyright (c) 2013, The Linux Foundation. All rights reserved.
 *
 * This program is free software; you can redistribute it and/or modify
 * it under the terms of the GNU General Public License version 2 and
 * only version 2 as published by the Free Software Foundation.
 *
 * This program is distributed in the hope that it will be useful,
 * but WITHOUT ANY WARRANTY; without even the implied warranty of
 * MERCHANTABILITY or FITNESS FOR A PARTICULAR PURPOSE.  See the
 * GNU General Public License for more details.
 */

/*---------------------------------------------------------------------------
 * This file is autogenerated file using gcdb parser. Please do not edit it.
 * Update input XML file to add a new entry or update variable in this file
 * VERSION = "1.0"
 *---------------------------------------------------------------------------*/
&mdss_mdp {
	dsi_nt35521_720_vid: qcom,mdss_dsi_nt35521_720p_video {
		qcom,mdss-dsi-panel-name = "nt35521 720p video mode dsi panel";
		qcom,mdss-dsi-panel-controller = <&mdss_dsi0>;
		qcom,mdss-dsi-panel-type = "dsi_video_mode";
		qcom,mdss-dsi-panel-destination = "display_1";
		qcom,mdss-dsi-panel-framerate = <60>;

		qcom,mdss-dsi-panel-id0-gpio = <&msmgpio 4 0>;    /* for glass_type detect */
		qcom,mdss-dsi-panel-id1-gpio = <&msmgpio 5 0>;    /* for glass_type detect */

		qcom,mdss-dsi-virtual-channel-id = <0>;
		qcom,mdss-dsi-stream = <0>;
		qcom,mdss-dsi-panel-width = <720>;
		qcom,mdss-dsi-panel-height = <1280>;
		qcom,mdss-dsi-h-front-porch = <120>;
		qcom,mdss-dsi-h-back-porch = <120>;
		qcom,mdss-dsi-h-pulse-width = <8>;
		qcom,mdss-dsi-h-sync-skew = <0>;
		qcom,mdss-dsi-v-back-porch = <20>;
		qcom,mdss-dsi-v-front-porch = <20>;
		qcom,mdss-dsi-v-pulse-width = <4>;
		qcom,mdss-dsi-h-left-border = <0>;
		qcom,mdss-dsi-h-right-border = <0>;
		qcom,mdss-dsi-v-top-border = <0>;
		qcom,mdss-dsi-v-bottom-border = <0>;
		qcom,mdss-dsi-bpp = <24>;
		qcom,mdss-dsi-underflow-color = <0xff>;
		qcom,mdss-dsi-border-color = <0>;
		qcom,mdss-dsi-pixel-packing = "tight";
		qcom,mdss-dsi-on-command-auo-asi = [29 01 00 00 00 00 06 f0 55 aa 52 08 00
					29 01 00 00 00 00 05 ff aa 55 a5 80
					29 01 00 00 00 00 03 b1 68 21
					29 01 00 00 00 00 06 bd 01 a3 20 10 01 
					23 01 00 00 00 00 02 6f 02 
					23 01 00 00 00 00 02 b8 08
					29 01 00 00 00 00 03 bb 11 11
					29 01 00 00 00 00 03 bc 00 00 
					23 01 00 00 00 00 02 b6 01
					29 01 00 00 00 00 03 d9 03 09 
					23 01 00 00 00 00 02 c8 83
					29 01 00 00 00 00 06 f0 55 aa 52 08 01
					29 01 00 00 00 00 03 b0 0f 0f
					29 01 00 00 00 00 03 b1 0f 0f 
					23 01 00 00 00 00 02 ce 66 
					23 01 00 00 00 00 02 c0 0c
					29 01 00 00 00 00 03 b5 05 05 
					23 01 00 00 00 00 02 be 48
					29 01 00 00 00 00 03 b3 28 28
					29 01 00 00 00 00 03 b4 19 19
					29 01 00 00 00 00 03 b9 34 34
					29 01 00 00 00 00 03 ba 24 24
					29 01 00 00 00 00 03 bc 70 00
					29 01 00 00 00 00 03 bd 70 00 
					23 01 00 00 00 00 02 ca 00
					29 01 00 00 00 00 06 f0 55 aa 52 08 02 
					23 01 00 00 00 00 02 ee 01
					29 01 00 00 00 00 11 b0 00 00 00 3e 00 67 00 92 00 ae 00 d6 00 f3 01 25
					29 01 00 00 00 00 11 b1 01 4c 01 88 01 b8 02 03 02 40 02 42 02 75 02 af
					29 01 00 00 00 00 11 b2 02 d7 03 00 03 1b 03 47 03 5d 03 7a 03 95 03 a6
					29 01 00 00 00 00 05 b3 03 ea 03 ff 
					23 01 00 00 00 00 02 6f 02 
					23 01 00 00 00 00 02 f8 44 
					23 01 00 00 00 00 02 6f 0f 
					23 01 00 00 00 00 02 fa 14 
					23 01 00 00 00 00 02 6f 02 
					23 01 00 00 00 00 02 f7 ef 
					23 01 00 00 00 00 02 6f 0a 
					23 01 00 00 00 00 02 f7 02 
					23 01 00 00 00 00 02 6f 0c 
					23 01 00 00 00 00 02 f4 d8 
					23 01 00 00 00 00 02 6f 0e 
					23 01 00 00 00 00 02 f4 44 
					23 01 00 00 00 00 02 6f 17 
					23 01 00 00 00 00 02 f4 60 
					23 01 00 00 00 00 02 6f 01 
					23 01 00 00 00 00 02 f9 46
					29 01 00 00 00 00 06 f0 55 aa 52 08 06
					29 01 00 00 00 00 03 b0 2e 2e
					29 01 00 00 00 00 03 b1 2e 2e
					29 01 00 00 00 00 03 b2 2e 2e
					29 01 00 00 00 00 03 b3 2e 09
					29 01 00 00 00 00 03 b4 0b 11
					29 01 00 00 00 00 03 b5 17 19
					29 01 00 00 00 00 03 b6 23 1d
					29 01 00 00 00 00 03 b7 25 1f
					29 01 00 00 00 00 03 b8 01 03
					29 01 00 00 00 00 03 b9 2e 2e
					29 01 00 00 00 00 03 ba 2e 2e
					29 01 00 00 00 00 03 bb 02 00
					29 01 00 00 00 00 03 bc 1e 24
					29 01 00 00 00 00 03 bd 1c 22
					29 01 00 00 00 00 03 be 18 16
					29 01 00 00 00 00 03 bf 10 0a
					29 01 00 00 00 00 03 c0 08 2e
					29 01 00 00 00 00 03 c1 2e 2e
					29 01 00 00 00 00 03 c2 2e 2e
					29 01 00 00 00 00 03 c3 2e 2e
					29 01 00 00 00 00 03 e5 13 12
					29 01 00 00 00 00 03 c4 2e 2e
					29 01 00 00 00 00 03 c5 2e 2e
					29 01 00 00 00 00 03 c6 2e 2e
					29 01 00 00 00 00 03 c7 2e 02
					29 01 00 00 00 00 03 c8 00 18
					29 01 00 00 00 00 03 c9 12 10
					29 01 00 00 00 00 03 ca 24 1e
					29 01 00 00 00 00 03 cb 22 1c
					29 01 00 00 00 00 03 cc 0a 08
					29 01 00 00 00 00 03 cd 2e 2e
					29 01 00 00 00 00 03 ce 2e 2e
					29 01 00 00 00 00 03 cf 09 0b
					29 01 00 00 00 00 03 d0 1d 23
					29 01 00 00 00 00 03 d1 1f 25
					29 01 00 00 00 00 03 d2 11 13
					29 01 00 00 00 00 03 d3 19 01
					29 01 00 00 00 00 03 d4 03 2e
					29 01 00 00 00 00 03 d5 2e 2e
					29 01 00 00 00 00 03 d6 2e 2e
					29 01 00 00 00 00 03 d7 2e 2e
					29 01 00 00 00 00 03 e6 16 17
					29 01 00 00 00 00 06 d8 00 00 00 00 00
					29 01 00 00 00 00 06 d9 00 00 00 00 00
					23 01 00 00 00 00 02 e7 00
					29 01 00 00 00 00 06 f0 55 aa 52 08 05
					23 01 00 00 00 00 02 ed 30
					29 01 00 00 00 00 06 f0 55 aa 52 08 03
					29 01 00 00 00 00 03 b0 20 00
					29 01 00 00 00 00 03 b1 20 00
					29 01 00 00 00 00 06 f0 55 aa 52 08 05
					29 01 00 00 00 00 03 b0 17 06 
					23 01 00 00 00 00 02 b8 00
					29 01 00 00 00 00 06 bd 0f 03 03 00 03
					29 01 00 00 00 00 03 b1 17 06
					29 01 00 00 00 00 03 b9 00 03
					29 01 00 00 00 00 03 b2 17 06
					29 01 00 00 00 00 03 ba 00 03
					29 01 00 00 00 00 03 b3 17 06
					29 01 00 00 00 00 03 bb 00 00
					29 01 00 00 00 00 03 b4 17 06
					29 01 00 00 00 00 03 b5 17 06
					29 01 00 00 00 00 03 b6 17 06
					29 01 00 00 00 00 03 b7 17 06
					29 01 00 00 00 00 03 bc 00 01 
					23 01 00 00 00 00 02 e5 06 
					23 01 00 00 00 00 02 e6 06 
					23 01 00 00 00 00 02 e7 06 
					23 01 00 00 00 00 02 e8 06 
					23 01 00 00 00 00 02 e9 0a 
					23 01 00 00 00 00 02 ea 06 
					23 01 00 00 00 00 02 eb 06 
					23 01 00 00 00 00 02 ec 06
					29 01 00 00 00 00 06 f0 55 aa 52 08 05 
					23 01 00 00 00 00 02 c0 07 
					23 01 00 00 00 00 02 c1 05
					29 01 00 00 00 00 06 f0 55 aa 52 08 03
					29 01 00 00 00 00 06 b2 04 00 52 01 51
					29 01 00 00 00 00 06 b3 04 00 52 01 51
					29 01 00 00 00 00 06 f0 55 aa 52 08 05 
					23 01 00 00 00 00 02 c4 82 
					23 01 00 00 00 00 02 c5 80
					29 01 00 00 00 00 06 f0 55 aa 52 08 03
					29 01 00 00 00 00 06 b6 04 00 52 01 51
					29 01 00 00 00 00 06 b7 04 00 52 01 51
					29 01 00 00 00 00 06 f0 55 aa 52 08 05
					29 01 00 00 00 00 03 c8 03 20
					29 01 00 00 00 00 03 c9 01 21
					29 01 00 00 00 00 03 ca 03 20
					29 01 00 00 00 00 03 cb 07 20
					29 01 00 00 00 00 06 f0 55 aa 52 08 03
					29 01 00 00 00 00 06 ba 44 00 60 01 72
					29 01 00 00 00 00 06 bb 44 00 60 01 72
					29 01 00 00 00 00 06 bc 53 00 03 00 48
					29 01 00 00 00 00 06 bd 53 00 03 00 48
					29 01 00 00 00 00 06 f0 55 aa 52 08 05
					29 01 00 00 00 00 0c d1 03 05 00 05 00 00 00 00 00 00 00
					29 01 00 00 00 00 0c d2 03 05 00 03 00 00 00 00 00 00 00
					29 01 00 00 00 00 0c d3 00 05 04 05 00 00 00 00 00 00 00
					29 01 00 00 00 00 0c d4 00 05 04 03 00 00 00 00 00 00 00
					29 01 00 00 00 00 06 f0 55 aa 52 08 03 
					23 01 00 00 00 00 02 c4 40 
					23 01 00 00 00 00 02 c5 40
					29 01 00 00 00 00 06 f0 55 aa 52 08 00 
					23 01 00 00 00 00 02 6f 08 
					23 01 00 00 00 00 02 f2 70 
					23 01 00 00 00 00 02 6f 02 
					23 01 00 00 00 00 02 b8 08 
					23 01 00 00 00 00 02 6f 07 
					23 01 00 00 00 00 02 f4 f0
					29 01 00 00 00 00 06 f0 55 aa 52 08 01 
					23 01 00 00 00 00 02 cb 92 
					23 01 00 00 00 00 02 cd 08 
					23 01 00 00 00 00 02 6f 01 
					23 01 00 00 00 00 02 cd 01 
					23 01 00 00 00 00 02 6f 01 
					23 01 00 00 00 00 02 cb 8a 
					23 01 00 00 00 00 02 bf 60 
					23 01 00 00 00 00 02 d3 40 
					23 01 00 00 00 00 02 6f 11 
					23 01 00 00 00 00 02 f3 01 
					05 01 00 00 78 00 02 11 00 
					05 01 00 00 64 00 02 29 00
					29 01 00 00 00 00 06 f0 55 aa 52 08 01
					29 01 00 00 00 00 06 f0 55 aa 52 00 00
					29 01 00 00 00 00 02 53 2c];
		qcom,mdss-dsi-on-command-lg = [29 01 00 00 00 00 06 f0 55 aa 52 08 00
					29 01 00 00 00 00 05 ff aa 55 a5 80
					29 01 00 00 00 00 02 f4 03
					29 01 00 00 00 00 03 6f 11 00
					29 01 00 00 00 00 03 f7 20 00
					29 01 00 00 00 00 02 6f 01
					29 01 00 00 00 00 02 b1 21
					29 01 00 00 00 00 06 bd 01 a0 10 08 01
					29 01 00 00 00 00 05 b8 01 02 0c 02
					29 01 00 00 00 00 03 bb cc cc
					29 01 00 00 00 00 03 bc 00 00
					29 01 00 00 00 00 02 b6 02
					29 01 00 00 00 00 03 d9 03 08
					29 01 00 00 00 00 06 f0 55 aa 52 08 01
					29 01 00 00 00 00 03 b0 09 09
					29 01 00 00 00 00 03 b1 09 09
					29 01 00 00 00 00 03 bc 8f 00
					29 01 00 00 00 00 03 bd 8f 00
					29 01 00 00 00 00 02 ca 00
					29 01 00 00 00 00 02 c0 04
					29 01 00 00 00 00 02 be 90
					29 01 00 00 00 00 03 b3 28 28
					29 01 00 00 00 00 03 b4 25 25
					29 01 00 00 00 00 03 b9 43 43
					29 01 00 00 00 00 03 ba 35 35
					29 01 00 00 00 00 06 f0 55 aa 52 08 02
					29 01 00 00 00 00 02 ee 01
					29 01 00 00 00 00 07 b0 00 00 00 12 00 37
					29 01 00 00 00 00 02 6f 06
					29 01 00 00 00 00 07 b0 00 5b 00 75 00 9a
					29 01 00 00 00 00 02 6f 0c
					29 01 00 00 00 00 05 b0 00 b8 00 e6
					29 01 00 00 00 00 07 b1 01 0b 01 43 01 72
					29 01 00 00 00 00 02 6f 06
					29 01 00 00 00 00 07 b1 01 bd 01 f7 01 fa
					29 01 00 00 00 00 02 6f 0c
					29 01 00 00 00 00 05 b1 02 32 02 74
					29 01 00 00 00 00 07 b2 02 9f 02 db 03 05
					29 01 00 00 00 00 02 6f 06
					29 01 00 00 00 00 07 b2 03 3c 03 60 03 8e
					29 01 00 00 00 00 02 6f 0c
					29 01 00 00 00 00 05 b2 03 aa 03 dc
					29 01 00 00 00 00 05 b3 03 fc 03 ff
					29 01 00 00 00 00 06 f0 55 aa 52 08 03
					29 01 00 00 00 00 03 b0 20 00
					29 01 00 00 00 00 03 b1 20 00
					29 01 00 00 00 00 06 b2 15 00 60 00 00
					29 01 00 00 00 00 06 b3 15 00 60 00 00
					29 01 00 00 00 00 06 b4 05 00 60 00 00
					29 01 00 00 00 00 06 b5 05 00 60 00 00
					29 01 00 00 00 00 06 ba 44 10 60 01 90
					29 01 00 00 00 00 06 bb 44 10 60 01 90
					29 01 00 00 00 00 06 bc 44 10 60 01 90
					29 01 00 00 00 00 06 bd 44 10 60 01 90
					29 01 00 00 00 00 05 c0 00 34 00 00
					29 01 00 00 00 00 05 c1 00 00 34 00
					29 01 00 00 00 00 05 c2 00 00 34 00
					29 01 00 00 00 00 05 c3 00 00 34 00
					29 01 00 00 00 00 02 c4 60
					29 01 00 00 00 00 02 c5 c0
					29 01 00 00 00 00 02 c6 00
					29 01 00 00 00 00 02 c7 00
					29 01 00 00 00 00 06 f0 55 aa 52 08 05
					29 01 00 00 00 00 03 b0 17 06
					29 01 00 00 00 00 03 b1 17 06
					29 01 00 00 00 00 03 b2 17 06
					29 01 00 00 00 00 03 b3 17 06
					29 01 00 00 00 00 03 b4 17 06
					29 01 00 00 00 00 03 b5 17 06
					29 01 00 00 00 00 03 b6 14 03
					29 01 00 00 00 00 03 b7 00 00
					29 01 00 00 00 00 02 b8 0c
					29 01 00 00 00 00 03 b9 00 03
					29 01 00 00 00 00 03 ba 00 01
					29 01 00 00 00 00 03 bb 0a 03
					29 01 00 00 00 00 03 bc 02 03
					29 01 00 00 00 00 06 bd 03 03 01 03 03
					29 01 00 00 00 00 02 c0 07
					29 01 00 00 00 00 02 c1 06
					29 01 00 00 00 00 02 c2 a6
					29 01 00 00 00 00 02 c3 05
					29 01 00 00 00 00 02 c4 a6
					29 01 00 00 00 00 02 c5 a6
					29 01 00 00 00 00 02 c6 a6
					29 01 00 00 00 00 02 c7 a6
					29 01 00 00 00 00 03 c8 05 20
					29 01 00 00 00 00 03 c9 04 20
					29 01 00 00 00 00 03 ca 01 25
					29 01 00 00 00 00 03 cb 01 60
					29 01 00 00 00 00 04 cc 00 00 01
					29 01 00 00 00 00 04 cd 00 00 01
					29 01 00 00 00 00 04 ce 00 00 02
					29 01 00 00 00 00 04 cf 00 00 02
					29 01 00 00 00 00 08 d0 00 00 00 00 00 00 00
					29 01 00 00 00 00 06 d1 00 35 01 07 10
					29 01 00 00 00 00 06 d2 10 35 02 03 10
					29 01 00 00 00 00 06 d3 20 00 43 07 10
					29 01 00 00 00 00 06 d4 30 00 43 07 10
					29 01 00 00 00 00 07 d5 00 00 00 00 00 00
					29 01 00 00 00 00 02 6f 06
					29 01 00 00 00 00 06 d5 00 00 00 00 00
					29 01 00 00 00 00 07 d6 00 00 00 00 00 00
					29 01 00 00 00 00 02 6f 06
					29 01 00 00 00 00 06 d6 00 00 00 00 00
					29 01 00 00 00 00 07 d7 00 00 00 00 00 00
					29 01 00 00 00 00 02 6f 06
					29 01 00 00 00 00 06 d7 00 00 00 00 00
					29 01 00 00 00 00 06 d8 00 00 00 00 00
					29 01 00 00 00 00 02 e5 06
					29 01 00 00 00 00 02 e6 06
					29 01 00 00 00 00 02 e7 06
					29 01 00 00 00 00 02 e8 06
					29 01 00 00 00 00 02 e9 06
					29 01 00 00 00 00 02 ea 06
					29 01 00 00 00 00 02 eb 00
					29 01 00 00 00 00 02 ec 00
					29 01 00 00 00 00 02 ed 30
					29 01 00 00 00 00 06 f0 55 aa 52 08 06
					29 01 00 00 00 00 03 b5 10 13
					29 01 00 00 00 00 03 b6 12 11
					29 01 00 00 00 00 03 b7 00 01
					29 01 00 00 00 00 03 b8 08 31
					29 01 00 00 00 00 03 b9 31 31
					29 01 00 00 00 00 03 ba 31 31
					29 01 00 00 00 00 03 bb 31 08
					29 01 00 00 00 00 03 bc 03 02
					29 01 00 00 00 00 03 bd 17 18
					29 01 00 00 00 00 03 be 19 16
					29 01 00 00 00 00 06 d8 00 00 00 00 00
					29 01 00 00 00 00 06 d9 00 00 00 00 00
					29 01 00 00 00 00 03 e5 00 00
					29 01 00 00 00 00 02 e7 00
					29 01 00 00 00 00 02 6f 01
					29 01 00 00 00 00 02 f9 46
					29 01 00 00 00 00 02 6f 11
					29 01 00 00 00 00 02 f3 01
					29 01 00 00 00 00 02 35 00 
					05 01 00 00 78 00 02 11 00 
					23 01 00 00 00 00 02 53 2c 
					23 01 00 00 00 00 02 51 50 
					23 01 00 00 00 00 02 55 01 
					05 01 00 00 32 00 02 29 00];
		qcom,mdss-dsi-off-command = [15 01 00 00 10 00 02 53 00
					05 01 00 00 32 00 02 28 00 
					05 01 00 00 64 00 02 10 00];
		qcom,mdss-dsi-on-command-state = "dsi_lp_mode";
		qcom,mdss-dsi-off-command-state = "dsi_hs_mode";
		qcom,mdss-dsi-h-sync-pulse = <1>;
		qcom,mdss-dsi-traffic-mode = "burst_mode";
		qcom,mdss-dsi-bllp-eof-power-mode;
		qcom,mdss-dsi-bllp-power-mode;
		qcom,mdss-dsi-lane-0-state;
		qcom,mdss-dsi-lane-1-state;
		qcom,mdss-dsi-lane-2-state;
		qcom,mdss-dsi-lane-3-state;
		qcom,mdss-dsi-panel-timings = [37 1c 12 00 42 44 18 20 17 03 04 00];
		qcom,mdss-dsi-t-clk-post = <0x20>;
		qcom,mdss-dsi-t-clk-pre = <0x2d>;
		qcom,mdss-dsi-bl-min-level = <30>;
		qcom,mdss-dsi-bl-max-level = <140>;
		qcom,mdss-dsi-dma-trigger = "trigger_sw";
		qcom,mdss-dsi-mdp-trigger = "none";
		qcom,mdss-dsi-bl-pmic-control-type = "bl_ctrl_dcs";
		qcom,mdss-dsi-reset-sequence = <1 20>, <0 1>, <1 20>;
		qcom,mdss-dsi-pan-enable-dynamic-fps;
		qcom,mdss-dsi-pan-fps-update = "dfps_immediate_porch_mode";
		qcom,mdss-dsi-min-refresh-rate = <45>;
	};
};
