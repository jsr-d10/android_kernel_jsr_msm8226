
qcom,jsr-4v35-6000mAh-ruilong-data {
	qcom,fcc-mah = <6000>;
	qcom,default-rbatt-mohm = <71>;
	qcom,rbatt-capacitive-mohm = <0>;
	qcom,flat-ocv-threshold-uv = <3800000>;
	qcom,max-voltage-uv = <4350000>;
	qcom,v-cutoff-uv = <3400000>;
	qcom,chg-term-ua = <100000>;
	qcom,batt-id-kohm = <200>;

	qcom,rbatt-sf-lut {
		qcom,lut-col-legend = <(-20) 0 25 40 60>;
		qcom,lut-row-legend = <100 95 90 85 80>,
				<75 70 65 60 55>,
				<50 45 40 35 30>,
				<25 20 16 13 11>,
				<10 9 8 7 6>,
				<5 4 3 2 1>;
		qcom,lut-data = <0x64 0x64 0x64 0x64 0x64 
				0x64 0x64 0x64 0x64 0x64 
				0x65 0x65 0x65 0x65 0x65 
				0x69 0x69 0x69 0x69 0x69 
				0x6d 0x6d 0x6d 0x6d 0x6d 
				0x76 0x76 0x76 0x76 0x76 
				0x79 0x79 0x79 0x79 0x79 
				0x7b 0x7b 0x7b 0x7b 0x7b 
				0x69 0x69 0x69 0x69 0x69 
				0x64 0x64 0x64 0x64 0x64 
				0x64 0x64 0x64 0x64 0x64 
				0x64 0x64 0x64 0x64 0x64 
				0x66 0x66 0x66 0x66 0x66 
				0x68 0x68 0x68 0x68 0x68 
				0x65 0x65 0x65 0x65 0x65 
				0x64 0x64 0x64 0x64 0x64 
				0x65 0x65 0x65 0x65 0x65 
				0x65 0x65 0x65 0x65 0x65 
				0x65 0x65 0x65 0x65 0x65 
				0x66 0x66 0x66 0x66 0x66 
				0x69 0x69 0x69 0x69 0x69 
				0x6c 0x6c 0x6c 0x6c 0x6c 
				0x6f 0x6f 0x6f 0x6f 0x6f 
				0x72 0x72 0x72 0x72 0x72 
				0x72 0x72 0x72 0x72 0x72 
				0x72 0x72 0x72 0x72 0x72 
				0x73 0x73 0x73 0x73 0x73 
				0x7a 0x7a 0x7a 0x7a 0x7a 
				0x88 0x88 0x88 0x88 0x88 
				0xe1 0xe1 0xe1 0xe1 0xe1>;
	};

	qcom,fcc-temp-lut {
		qcom,lut-col-legend = <(-20) 0 25 40 60>;
		qcom,lut-data = <0x17f6 0x17f6 0x17f6 0x17f6 0x17f6>;
	};

	qcom,pc-temp-ocv-lut {
		qcom,lut-col-legend = <(-20) 0 25 40 60>;
		qcom,lut-row-legend = <100 95 90 85 80>,
				<75 70 65 60 55>,
				<50 45 40 35 30>,
				<25 20 16 13 11>,
				<10 9 8 7 6>,
				<5 4 3 2 1>,
				<0>;
		qcom,lut-data = <0x10ef 0x10ef 0x10ef 0x10ef 0x10ef 
				0x10af 0x10af 0x10af 0x10af 0x10af 
				0x1074 0x1074 0x1074 0x1074 0x1074 
				0x103d 0x103d 0x103d 0x103d 0x103d 
				0x1008 0x1008 0x1008 0x1008 0x1008 
				0xfdc 0xfdc 0xfdc 0xfdc 0xfdc 
				0xf9f 0xf9f 0xf9f 0xf9f 0xf9f 
				0xf75 0xf75 0xf75 0xf75 0xf75 
				0xf46 0xf46 0xf46 0xf46 0xf46 
				0xf21 0xf21 0xf21 0xf21 0xf21 
				0xf05 0xf05 0xf05 0xf05 0xf05 
				0xeee 0xeee 0xeee 0xeee 0xeee 
				0xedb 0xedb 0xedb 0xedb 0xedb 
				0xec9 0xec9 0xec9 0xec9 0xec9 
				0xeb8 0xeb8 0xeb8 0xeb8 0xeb8 
				0xea7 0xea7 0xea7 0xea7 0xea7 
				0xe95 0xe95 0xe95 0xe95 0xe95 
				0xe82 0xe82 0xe82 0xe82 0xe82 
				0xe6f 0xe6f 0xe6f 0xe6f 0xe6f 
				0xe6a 0xe6a 0xe6a 0xe6a 0xe6a 
				0xe68 0xe68 0xe68 0xe68 0xe68 
				0xe66 0xe66 0xe66 0xe66 0xe66 
				0xe63 0xe63 0xe63 0xe63 0xe63 
				0xe5d 0xe5d 0xe5d 0xe5d 0xe5d 
				0xe4c 0xe4c 0xe4c 0xe4c 0xe4c 
				0xe2b 0xe2b 0xe2b 0xe2b 0xe2b 
				0xdfd 0xdfd 0xdfd 0xdfd 0xdfd 
				0xdc1 0xdc1 0xdc1 0xdc1 0xdc1 
				0xd6d 0xd6d 0xd6d 0xd6d 0xd6d 
				0xceb 0xceb 0xceb 0xceb 0xceb 
				0xbb8 0xbb8 0xbb8 0xbb8 0xbb8>;
	};
};
